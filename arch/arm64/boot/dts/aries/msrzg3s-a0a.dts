// SPDX-License-Identifier: (GPL-2.0-only OR BSD-2-Clause)
/*
 * Device Tree Source for the ARIES embedded MSRZG3S OSM on G3SBerry board
 *
 * Copyright (C) 2025 ARIES Embedded
 */

/dts-v1/;

#include "../renesas/r9a08g045s33.dtsi"
#include "msrzg3s.dtsi"

/ {
	model = "ARIES Embedded MSRZG3S-A0A OSM on G3Sberry";
	compatible = "aries,msrzg3-a0a", "aries,msrzg3",
		     "renesas,r9a08g045s33", "renesas,r9a08g045";

	memory@48000000 {
		device_type = "memory";
		/* First 128MB is reserved for secure area. */
		reg = <0x0 0x48000000 0x0 0x18000000>;
	};
};
